## arch/arm/mach-imx/imx8m/Kconfig
```kconfig
if ARCH_IMX8M

config IMX8M
	bool
	select HAS_CAAM
	select ROM_UNIFIED_SECTIONS

config IMX8MQ
	bool
	select IMX8M
	select ARMV8_SPL_EXCEPTION_VECTORS

config IMX8MM
	bool
	select IMX8M
	select ARMV8_SPL_EXCEPTION_VECTORS

config IMX8MN
	bool
	select IMX8M
	select ARMV8_SPL_EXCEPTION_VECTORS

config IMX8MP
	bool
	select IMX8M

config SYS_SOC
	default "imx8m"

config SPL_WITH_DDR_FIRMWARE
	bool "Enable build for SPL with DDR firmware attached"
	depends on IMX8MQ || IMX8MM
	help
	  Add SPL step to the build which attaches DDR firmware
	  and IVT header for booting directly on HW without the
	  use of imx-boot.
	  NOTE: DDR firmware should be placed at the base of
	  the build directory.  Also set:
	  CONFIG_SYS_EXTRA_OPTIONS="IMX_CONFIG=arch/arm/mach-imx/imx8m/imximage-8mm-lpddr4-spl.cfg"

config SPL_WITH_DDR_FIRMWARE_LPDDR_FLAG
	bool "DDR firmware is for lpddr HW"
	default y
	depends on SPL_WITH_DDR_FIRMWARE
	help
	  Use this flag to specify which DDR firmware to use
	  DDR4 or LPDDR4.

config SECONDARY_BOOT_SECTOR_OFFSET
	hex "SD/MMC sector offset used for ROM secondary boot"
	default 0x0
	depends on IMX8MQ || IMX8MM
	help
	  Set the sector offset to non-zero value in SPL used for
	  secondary boot image. This value should be same as the
	  firstSectorNumber in secondary image table.

config SECURE_STICKY_BITS_LOCKUP
	bool "Enable workaround to fix sticky bits lock up issue"
	depends on IMX8MQ && IMX_HAB
	default y

config IMX_UNIQUE_ID
	hex "Enable workaround to fix sticky bits lock up issue"
	depends on IMX8MQ && IMX_HAB && !SECURE_STICKY_BITS_LOCKUP
	default 0x0

choice
	prompt  "NXP i.MX8M board select"
	optional

config TARGET_IMX8MQ_EVK
	bool "imx8mq_evk"
	select IMX8MQ
	select IMX8M_LPDDR4

config TARGET_IMX8MQ_DDR3L_VAL
	bool "imx8mq_ddr3l_val"
	select IMX8MQ

config TARGET_IMX8MQ_DDR4_VAL
	bool "imx8mq_ddr4_val"
	select IMX8MQ

config TARGET_IMX8MM_DDR4_VAL
	bool "imx8mm DDR4 validation board"
	select IMX8MM
	select SUPPORT_SPL
	select IMX8M_DDR4

config TARGET_IMX8MM_DDR3L_VAL
	bool "imx8mm DDR3L validation board"
	select IMX8MM
	select SUPPORT_SPL
	select IMX8M_DDR3L

config TARGET_IMX8MM_EVK
	bool "imx8mm LPDDR4 EVK board"
	select IMX8MM
	select SUPPORT_SPL
	select IMX8M_LPDDR4

config TARGET_IMX8MM_DDR4_EVK
	bool "imx8mm DDR4 EVK board"
	select IMX8MM
	select SUPPORT_SPL
	select IMX8M_DDR4

config TARGET_IMX8MN_EVK
	bool "imx8mn LPDDR4 EVK board"
	select IMX8MN
	select SUPPORT_SPL
	select IMX8M_LPDDR4

config TARGET_IMX8MN_DDR4_EVK
	bool "imx8mn DDR4 EVK board"
	select IMX8MN
	select SUPPORT_SPL
	select IMX8M_DDR4

config TARGET_IMX8MP_EVK
	bool "imx8mp LPDDR4 EVK board"
	select IMX8MP
	select SUPPORT_SPL
	select IMX8M_LPDDR4

config TARGET_IMX8MM_AB2
	bool "imx8mm LPDDR4 Audio board 2.0"
	select IMX8MM
	select SUPPORT_SPL
	select IMX8M_LPDDR4

config TARGET_IMX8MN_AB2
	bool "imx8mn LPDDR4 Audio board 2.0"
	select IMX8MN
	select SUPPORT_SPL
	select IMX8M_LPDDR4

config TARGET_IMX8MN_DDR4_AB2
	bool "imx8mn DDR4 Audio board 2.0"
	select IMX8MN
	select SUPPORT_SPL
	select IMX8M_DDR4

config TARGET_VERDIN_IMX8MM
       bool "Support Toradex Verdin iMX8M Mini module"
       select IMX8MM
       select SUPPORT_SPL
       select IMX8M_LPDDR4

config TARGET_VERDIN_IMX8MP
       bool "Support Toradex Verdin iMX8M Plus module"
	select IMX8MP
	select SUPPORT_SPL
	select IMX8M_LPDDR4

endchoice

source "board/freescale/imx8mq_evk/Kconfig"
source "board/freescale/imx8mq_val/Kconfig"
source "board/freescale/imx8mm_ab2/Kconfig"
source "board/freescale/imx8mm_evk/Kconfig"
source "board/freescale/imx8mm_val/Kconfig"
source "board/freescale/imx8mn_evk/Kconfig"
source "board/freescale/imx8mp_evk/Kconfig"
source "board/toradex/verdin-imx8mm/Kconfig"
source "board/toradex/verdin-imx8mp/Kconfig"

endif
```

## configs/avnet_secure_rpi_3_defconfig
```kconfig
CONFIG_ARM=y
CONFIG_ARCH_BCM283X=y
CONFIG_SYS_TEXT_BASE=0x00080000
CONFIG_TARGET_RPI_3_64B=y
CONFIG_SYS_MALLOC_F_LEN=0x2000
CONFIG_CMD_HDMIDETECT=y
CONFIG_DISTRO_DEFAULTS=y
CONFIG_NR_DRAM_BANKS=1
CONFIG_OF_BOARD_SETUP=y
CONFIG_BOOTDELAY=0
CONFIG_BOOTCOMMAND="mmc dev 0 ; tpm2 startup TPM2_SU_CLEAR ; time ; fatload mmc 0:1 ${kernel_addr_r} zImage ;  sha1sum ${kernel_addr_r} ${filesize} ; tpm2 pcr_extend 0 0x2700000 ;setenv bootargs dwc_otg.lpm_enable=0 console=tty1 rootfstype=ext4 rootwait root=/dev/mmcblk0p2 fsck.repair=yes elevator=deadline ;  bootz ${kernel_addr_r} - ${fdt_addr} "
CONFIG_LOG_TEST=y
CONFIG_LOG_ERROR_RETURN=y
CONFIG_MISC_INIT_R=y
# CONFIG_DISPLAY_CPUINFO is not set
# CONFIG_DISPLAY_BOARDINFO is not set
CONFIG_SYS_PROMPT="U-Boot> "
CONFIG_AUTOBOOT_KEYED=y
CONFIG_AUTOBOOT_PROMPT="n"
CONFIG_CMD_SHA1SUM=y
CONFIG_SHA1SUM_VERIFY=y
# CONFIG_CMD_FLASH is not set
CONFIG_CMD_GPIO=y
CONFIG_RANDOM_UUID=y
CONFIG_CMD_MMC=y
CONFIG_CMD_SPI=y
CONFIG_CMD_USB=y
CONFIG_CMD_LINK_LOCAL=y
CONFIG_CMD_TIME=y
CONFIG_CMD_UUID=y
CONFIG_CMD_AES=y
CONFIG_CMD_TPM=y
CONFIG_CMD_EXT4_WRITE=y
CONFIG_PARTITION_TYPE_GUID=y
CONFIG_DEFAULT_DEVICE_TREE="bcm2710-rpi-custom"
CONFIG_ENV_FAT_INTERFACE="mmc"
CONFIG_ENV_FAT_DEVICE_AND_PART="0:1"
CONFIG_ENV_VARS_UBOOT_RUNTIME_CONFIG=y
CONFIG_DM_KEYBOARD=y
CONFIG_DM_MMC=y
CONFIG_MMC_SDHCI=y
CONFIG_MMC_SDHCI_BCM2835=y
CONFIG_PHYLIB=y
CONFIG_DM_ETH=y
CONFIG_PINCTRL=y
# CONFIG_PINCTRL_GENERIC is not set
# CONFIG_REQUIRE_SERIAL_CONSOLE is not set
CONFIG_SPI=y
CONFIG_DM_SPI=y
CONFIG_SPI_MEM=y
# CONFIG_TPM_V1 is not set
CONFIG_TPM2_TIS_SPI=y
CONFIG_USB=y
CONFIG_DM_USB=y
CONFIG_USB_DWC2=y
CONFIG_USB_STORAGE=y
CONFIG_USB_KEYBOARD=y
CONFIG_USB_HOST_ETHER=y
CONFIG_USB_ETHER_LAN78XX=y
CONFIG_USB_ETHER_SMSC95XX=y
CONFIG_DM_VIDEO=y
CONFIG_SYS_WHITE_ON_BLACK=y
CONFIG_CONSOLE_SCROLL_LINES=10
CONFIG_PHYS_TO_BUS=y
CONFIG_RSA=y
CONFIG_SPL_RSA=y
CONFIG_TPM=y
CONFIG_SHA256=y
CONFIG_OF_LIBFDT_OVERLAY=y
```
